## sdkconfig.defaults
```kconfig
# Native ESP32 speaker with Classic Bluetooth and the internal SBC decoder.
CONFIG_IDF_TARGET="esp32"
CONFIG_ESPTOOLPY_FLASHSIZE_4MB=y
CONFIG_ESPTOOLPY_FLASHMODE_DIO=y
CONFIG_ESPTOOLPY_FLASHFREQ_40M=y
CONFIG_PARTITION_TABLE_CUSTOM=y
CONFIG_PARTITION_TABLE_CUSTOM_FILENAME="partitions.csv"
CONFIG_PARTITION_TABLE_OFFSET=0x8000
CONFIG_ESP_CONSOLE_UART_DEFAULT=y
CONFIG_ESP_CONSOLE_UART_BAUDRATE=115200
CONFIG_LOG_DEFAULT_LEVEL_INFO=y
CONFIG_FREERTOS_HZ=100
CONFIG_ESP_MAIN_TASK_STACK_SIZE=4096
CONFIG_ESP_DEFAULT_CPU_FREQ_MHZ_240=y
CONFIG_BT_ENABLED=y
CONFIG_BTDM_CTRL_MODE_BR_EDR_ONLY=y
CONFIG_BT_BLUEDROID_ENABLED=y
CONFIG_BT_CLASSIC_ENABLED=y
CONFIG_BT_A2DP_ENABLE=y
CONFIG_BT_BTC_TASK_STACK_SIZE=4096
# CONFIG_BT_A2DP_USE_EXTERNAL_CODEC is not set
# CONFIG_BT_BLE_ENABLED is not set
# CONFIG_BT_SPP_ENABLED is not set
# CONFIG_BT_HFP_ENABLE is not set
# CONFIG_BT_AVRCP_CT_COVER_ART_ENABLED is not set
# Native button driver: 10 ms scans x 4 samples = 40 ms debounce.
CONFIG_BUTTON_PERIOD_TIME_MS=10
CONFIG_BUTTON_DEBOUNCE_TICKS=4
```
